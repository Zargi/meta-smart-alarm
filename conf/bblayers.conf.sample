## conf/bblayers.conf.sample
```bitbake
LCONF_VERSION = "1"

BBPATH = "${TOPDIR}"
BSPDIR := "${@os.path.abspath(os.path.dirname(d.getVar('FILE', True)) + '/../..')}"

BBFILES ?= ""
BBLAYERS ?= " \
  ${BSPDIR}/source/poky/meta \
  ${BSPDIR}/source/poky/meta-poky \
  ${BSPDIR}/source/meta-openembedded/meta-oe \
  ${BSPDIR}/source/meta-openembedded/meta-multimedia \
  ${BSPDIR}/source/meta-openembedded/meta-networking \
  ${BSPDIR}/source/meta-openembedded/meta-python \
  ${BSPDIR}/source/meta-raspberrypi \
  ${BSPDIR}/source/meta-qt5 \
  ${BSPDIR}/source/meta-smart-alarm \
  "
```

## conf/layer.conf
```bitbake
# We have a conf and classes directory, add to BBPATH
BBPATH .= ":${LAYERDIR}"

# We have recipes-* directories, add to BBFILES
BBFILES += "${LAYERDIR}/recipes-*/*/*.bb \
	${LAYERDIR}/recipes-*/*/*.bbappend"

BBFILE_COLLECTIONS += "smart-alarm"
BBFILE_PATTERN_smart-alarm = "^${LAYERDIR}/"
BBFILE_PRIORITY_smart-alarm = "10"
```
